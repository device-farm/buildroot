## package/device-farm/Config.in
```kconfig
config BR2_PACKAGE_DEVICE_FARM
	bool "device.farm connected device"
	select BR2_PACKAGE_WIREGUARD_TOOLS
	select BR2_PACKAGE_IPROUTE2
	select BR2_PACKAGE_IPTABLES
	select BR2_PACKAGE_DOCKER_ENGINE
	select BR2_PACKAGE_DOCKER_ENGINE_DRIVER_VFS
	depends on BR2_LINUX_KERNEL
	help
	  This is a meta package for dependencies required to connect the device to DEVICE.FARM.

	  http://www.device.farm

comment "device-farm needs docker-engine which needs a glibc or musl toolchain w/ threads and a Linux kernel to be built"
	depends on BR2_LINUX_KERNEL
	depends on BR2_PACKAGE_HOST_GO_TARGET_ARCH_SUPPORTS
	depends on BR2_PACKAGE_HOST_GO_TARGET_CGO_LINKING_SUPPORTS
	depends on !BR2_TOOLCHAIN_HAS_THREADS || BR2_TOOLCHAIN_USES_UCLIBC
	depends on BR2_USE_MMU
```
